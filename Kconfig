## Kconfig
```kconfig
menu "Golain"

    config GOLAIN_ROOT_TOPIC
        string "Root Topic"
        default "/xxxx_xxxx/"
        help
            The root topic for all MQTT messages. Get this from connection_settings.json after creating a device in Golain Platform

    config GOLAIN_DEVICE_NAME
        string "Device Name"
        default "xxxx"
        help
            The name of the device. Same as the name in Golain Platform - Get this from connection_settings.json after creating a device in Golain Platform

    config GOLAIN_WIFI
        bool "Enable Wifi"
        help
            Enables simple managed Wifi. If disabled, user must manually connect to the internet via other means.

    config WIFI_SSID
        string "Wifi SSID"
        depends on GOLAIN_WIFI
        default "Enter ssid"
        help
            The wifi ssid of your prefered wifi network
    
    config WIFI_PASSWORD
        string "Wifi password"
        default "Enter wifi password"
        depends on GOLAIN_WIFI
        help
            The wifi password of your prefered wifi network

    choice ESP_WIFI_SCAN_AUTH_MODE_THRESHOLD
        prompt "WiFi Scan auth mode threshold"
        default ESP_WIFI_AUTH_WPA2_PSK
        depends on GOLAIN_WIFI
        help
            The weakest authmode to accept in the scan mode.
            This value defaults to ESP_WIFI_AUTH_WPA2_PSK incase password is present and ESP_WIFI_AUTH_OPEN is used.
            Please select ESP_WIFI_AUTH_WEP/ESP_WIFI_AUTH_WPA_PSK incase AP is operating in WEP/WPA mode.
        
        config ESP_WIFI_AUTH_OPEN
            bool "OPEN"
        config ESP_WIFI_AUTH_WEP
            bool "WEP"
        config ESP_WIFI_AUTH_WPA_PSK
            bool "WPA PSK"
        config ESP_WIFI_AUTH_WPA2_PSK
            bool "WPA2 PSK"
        config ESP_WIFI_AUTH_WPA_WPA2_PSK
            bool "WPA/WPA2 PSK"
        config ESP_WIFI_AUTH_WPA3_PSK
            bool "WPA3 PSK"
        config ESP_WIFI_AUTH_WPA2_WPA3_PSK
            bool "WPA2/WPA3 PSK"
        config ESP_WIFI_AUTH_WAPI_PSK
            bool "WAPI PSK"
    endchoice

    config GOLAIN_BLE
        bool "Enable BLE Services for Golain"
        help
            Allows interaction with device via BLE. Uses the NimBLE stack with custom services and characteristics. Works best with the Golain Flutter SDKs.
    
    config GOLAIN_MQTT_OTA
        bool "Enable OTA Updates via MQTT"
        help
            Allows for Generic OTA updates via MQTT. Firmware updates are handled implicitly, others must be handled by the user.
    
    menu "Persistent Logging"

        config GOLAIN_CLOUD_LOGGING
            bool "Enable Persistent Cloud Logging"
            help
                Adds support for persistent logging and push-to-cloud logs. Use P_ESP_LOG* macros to log to the cloud & console.

        config GOLAIN_MAX_PERSISTENT_LOGS
            int "Maximum number of persistent logs"
            depends on GOLAIN_CLOUD_LOGGING
            default 50
            help
                This option specifies the maximum number of persistent logs
                that can be stored on the system.  Persistent logs are
                stored in NVS partition.
        
        config PERSISTENT_LOGS_INTERNAL_LOG_LEVEL
            int "Internal log level"
            depends on GOLAIN_CLOUD_LOGGING
            default 3
            help
                This option specifies the internal log level for persistent
                logs.  The value is a bitmask of log levels.  The default
                value is 3, which means that both ERROR and WARNING logs
                will be stored.

        menu "Device Health"

        config GOLAIN_REPORT_DEVICE_HEALTH
            bool "Report Device Health"
            depends on GOLAIN_CLOUD_LOGGING
            help
                Reports device health to the cloud. This includes the device's free heap, uptime, and other useful information.

            config GOLAIN_DEVICE_HEALTH_BUFFER_SIZE
                int "Device health buffer size"
                depends on GOLAIN_REPORT_DEVICE_HEALTH
                default 256
                help
                    Device health buffer size.
        endmenu

    endmenu

config GOLAIN_SHADOW_BUFFER_SIZE
        int "Shadow Buffer Size"
        default 128
        help
            The size of the shadow buffer. This is used to store the device's shadow document. Increase this if you have a large shadow document.

config GOLAIN_CONSUMER_ENABLED
        bool "Enable Consumer applictions"
        help
            Enables consumer applications & user association. See Docs for more info.

endmenu
```

## golain-mqtt/Kconfig
```kconfig
menu "Golain MQTT Configuration"
    config MQTT_PORT
        int "URI port for the mqtt broker"
        default 8083

    config BROKER_URI
        string "Broker URL"
        default "mqtts://dev.golain.io"
        help
            URL of an mqtt broker which this example connects to.

    
    config MESSAGE_NAMES
        string "Protobuff message names"
        default "shadow,end"
        help
            A comma separated list of you protobuf message names

    config NUMBER_OF_MESSAGES
        int "Number of proto messages"
        default 2
        help
            Number of protobuf messages

    config TOPIC_ROOT   
        string "Path to the root topic for your project"
        default "<Insert root topic>"
        
    config DEVICE_NAME
        string "Name of your device"
        default "<Insert device name>"
    
    config ESP_WIFI_SSID
                string "WiFi SSID"
                default "myssid"
                help
                    SSID (network name) for the example to connect to.
        
    config ESP_WIFI_PASSWORD
                string "WiFi Password"
                default "mypassword"
                help
                    WiFi password (WPA or WPA2) for the example to use.
        
    config ESP_MAXIMUM_RETRY
                int "Maximum retry"
                default 5
                help
                    Set the Maximum retry to avoid station reconnecting to the AP unlimited when the AP is really inexistent.
        
            choice ESP_WIFI_SCAN_AUTH_MODE_THRESHOLD
                prompt "WiFi Scan auth mode threshold"
                default ESP_WIFI_AUTH_WPA2_PSK
                help
                    The weakest authmode to accept in the scan mode.
                    This value defaults to ESP_WIFI_AUTH_WPA2_PSK incase password is present and ESP_WIFI_AUTH_OPEN is used.
                    Please select ESP_WIFI_AUTH_WEP/ESP_WIFI_AUTH_WPA_PSK incase AP is operating in WEP/WPA mode.
        
                config ESP_WIFI_AUTH_OPEN
                    bool "OPEN"
                config ESP_WIFI_AUTH_WEP
                    bool "WEP"
                config ESP_WIFI_AUTH_WPA_PSK
                    bool "WPA PSK"
                config ESP_WIFI_AUTH_WPA2_PSK
                    bool "WPA2 PSK"
                config ESP_WIFI_AUTH_WPA_WPA2_PSK
                    bool "WPA/WPA2 PSK"
                config ESP_WIFI_AUTH_WPA3_PSK
                    bool "WPA3 PSK"
                config ESP_WIFI_AUTH_WPA2_WPA3_PSK
                    bool "WPA2/WPA3 PSK"
                config ESP_WIFI_AUTH_WAPI_PSK
                    bool "WAPI PSK"
            endchoice

endmenu
```

## old/device-health/Kconfig
```kconfig
menu device_health

    config RESET_COUNTER_KEY
        string "Reset counter key for NVS store"
        default "r-key"
        help
            Key for reset counter in NVS store.
    
    config DEVICE_HEALTH_STORE
        string "NVS store for device health"
        default "device-health"
        help
            NVS store for device health.
    
    config DEVICE_HEALTH_BUFFER_SIZE
        int "Device health buffer size"
        default 256
        help
            Device health buffer size.
    
    config NVS_STORE_KEY
        string "NVS store key"
        default "store"
        help
            NVS store key.

endmenu
```

## old/device-shadow/Kconfig
```kconfig
menu device_shadow

    config DEVICE_SHADOW_BUFFER_SIZE
        int "Device shadow buffer size"
        default 256
        help
            Device shadow buffer size.

endmenu
```

## persistent_logs/Kconfig
```kconfig
menu persistent_logs

    config MAX_PERSISTENT_LOGS
        int "Maximum number of persistent logs"
        default 50
        help
            This option specifies the maximum number of persistent logs
            that can be stored on the system.  Persistent logs are
            stored in NVS partition.
    
    config PERSISTENT_LOGS_INTERNAL_LOG_LEVEL
        int "Internal log level"
        default 0
        help
            This option specifies the internal log level for persistent
            logs.  The value is a bitmask of log levels.  The default
            value is 3, which means that both ERROR and WARNING logs
            will be stored.

endmenu
```

## sdkconfig.defaults.esp32
```kconfig
#
# Golain device settings
#

CONFIG_GOLAIN_DEVICE_NAME="xxxx"

#
# Bluetooth enabled
#

CONFIG_BT_ENABLED=y
CONFIG_BT_NIMBLE_ENABLED=y
CONFIG_BT_NIMBLE_SVC_GAP_DEVICE_NAME=CONFIG_GOLAIN_DEVICE_NAME
```
